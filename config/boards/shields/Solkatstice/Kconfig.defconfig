## config/boards/shields/solkatsticea/Kconfig.defconfig
```kconfig
if SHIELD_SOLKATSTICE
  config ZMK_KEYBOARD_NAME
    default "solkatstice"
endif
```

## config/west.yml
```yaml
manifest:
  remotes:
    - name: zmkfirmware
      url-base: https://github.com/zmkfirmware
    - name: caksoylar
      url-base: https://github.com/caksoylar
    - name: badjeff
      url-base: https://github.com/badjeff
    - name: te9no
      url-base: https://github.com/te9no
    - name: urob
      url-base: https://github.com/urob
    - name: mctechnology17
      url-base: https://github.com/mctechnology17
  projects:
    - name: zmk
      remote: zmkfirmware
    #  revision: main
      revision: v0.2.1
      import: app/west.yml
    #- name: zmk
    #  remote: urob
    #  revision: v0.2+fix-child-nodes
    #  import: app/west.yml
    - name: zmk-rgbled-widget
      remote: caksoylar
      revision: main
    - name: zmk-pmw3610-driver
      remote: badjeff
      revision: main
    - name: zmk-analog-input-driver
      remote: badjeff
      revision: main
    - name: zmk-leader-key
      remote: urob
      revision: v0.2.1 # set to same as ZMK version above
    # - name: zmk-dongle-display
    #   remote: te9no
    #   revision: test
    # - name: zmk-nice-oled
    #   remote: te9no
    #   revision: main
    - name: zmk-dongle-display-view
      remote: te9no
      revision: main
  self:
    path: config
```
